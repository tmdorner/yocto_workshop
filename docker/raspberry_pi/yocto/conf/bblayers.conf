## docker/raspberry_pi/yocto/conf/bblayers.conf
```bitbake
# POKY_BBLAYERS_CONF_VERSION is increased each time build/conf/bblayers.conf
# changes incompatibly
POKY_BBLAYERS_CONF_VERSION = "2"

BBPATH = "${TOPDIR}"
BBFILES ?= ""

BBLAYERS ?= " \
  /home/build/oe-core/layers/poky/meta \
  /home/build/oe-core/layers/poky/meta-poky \
  /home/build/oe-core/layers/poky/meta-yocto-bsp \
  /home/build/oe-core/layers/meta-openembedded/meta-oe \
  /home/build/oe-core/layers/meta-openembedded/meta-python \
  /home/build/oe-core/layers/meta-openembedded/meta-multimedia \
  /home/build/oe-core/layers/meta-openembedded/meta-networking \
  /home/build/oe-core/layers/meta-raspberrypi \
  /home/build/oe-core/layers/meta-workshop \
  "
```
